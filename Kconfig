## Kconfig
```kconfig
# SPDX-FileCopyrightText: 2026 roolrz
# SPDX-License-Identifier: Apache-2.0

config SYSTEM_APP_JOURNALCTL
    bool "journalctl (/bin/journalctl)"
    default y
    depends on SYSTEM_APP_SVC_JOURNAL
    help
        Build and deploy hyper-journalctl at /bin/journalctl.
```
